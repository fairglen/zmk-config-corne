## config/boards/shields/joycorne/Kconfig.defconfig
```kconfig
if SHIELD_JOYCORNE_LEFT

config ZMK_KEYBOARD_NAME
    default "JoyCorne Left"

config ZMK_SPLIT_BLE_ROLE_CENTRAL
    default y

endif

if SHIELD_JOYCORNE_RIGHT

config ZMK_KEYBOARD_NAME
    default "JoyCorne Right"

endif

if SHIELD_JOYCORNE_LEFT || SHIELD_JOYCORNE_RIGHT

config ZMK_SPLIT
    default y

endif
```

## config/boards/shields/joycorne/Kconfig.shield
```kconfig
config SHIELD_JOYCORNE_LEFT
	def_bool $(shields_list_contains,joycorne_left)

config SHIELD_JOYCORNE_RIGHT
	def_bool $(shields_list_contains,joycorne_right)
```
